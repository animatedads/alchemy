## packages/oorexx_xtp_v0.1-dev37/kernel/Kconfig
```kconfig
config XTP
    tristate "Xpress Transfer Protocol (XTP)"
    help
      RexxOS XTP kernel provider.  Select Y for a RexxOS kernel built with XTP
      resident, or M while developing the kernel provider as a loadable module.
```
